## 06_TryYoctoCMakeCpp/meta-hellocpp/conf/layer.conf
```bitbake
# We have a conf and classes directory, add to BBPATH
BBPATH .= ":${LAYERDIR}"

# We have recipes-* directories, add to BBFILES
BBFILES += "${LAYERDIR}/recipes-*/*/*.bb \
            ${LAYERDIR}/recipes-*/*/*.bbappend"

BBFILE_COLLECTIONS += "meta-hellocpp"
BBFILE_PATTERN_meta-hellocpp = "^${LAYERDIR}/"
BBFILE_PRIORITY_meta-hellocpp = "6"

LAYERDEPENDS_meta-hellocpp = "core"
LAYERSERIES_COMPAT_meta-hellocpp = "dunfell"
```

## 07_YoctoBoost/meta-yoctoboost/conf/layer.conf
```bitbake
# We have a conf and classes directory, add to BBPATH
BBPATH .= ":${LAYERDIR}"

# We have recipes-* directories, add to BBFILES
BBFILES += "${LAYERDIR}/recipes-*/*/*.bb \
            ${LAYERDIR}/recipes-*/*/*.bbappend"

BBFILE_COLLECTIONS += "meta-yoctoboost"
BBFILE_PATTERN_meta-yoctoboost = "^${LAYERDIR}/"
BBFILE_PRIORITY_meta-yoctoboost = "6"

LAYERDEPENDS_meta-yoctoboost = "core"
LAYERSERIES_COMPAT_meta-yoctoboost = "dunfell"
```

## 10_YoctoXenomaiHelloWorld/meta-helloxenomai/conf/layer.conf
```bitbake
# We have a conf and classes directory, add to BBPATH
BBPATH .= ":${LAYERDIR}"

# We have recipes-* directories, add to BBFILES
BBFILES += "${LAYERDIR}/recipes-*/*/*.bb \
            ${LAYERDIR}/recipes-*/*/*.bbappend"

BBFILE_COLLECTIONS += "meta-helloxenomai"
BBFILE_PATTERN_meta-helloxenomai = "^${LAYERDIR}/"
BBFILE_PRIORITY_meta-helloxenomai = "6"

LAYERDEPENDS_meta-helloxenomai = "core"
LAYERSERIES_COMPAT_meta-helloxenomai = "sumo"
```
